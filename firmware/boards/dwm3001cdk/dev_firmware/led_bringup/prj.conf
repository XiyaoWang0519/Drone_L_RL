## CMakeLists.txt
```
# ============================================================================
# CMakeLists.txt for DWM3001CDK LED Bring-up Application
# ============================================================================
# This file configures the build system for a simple LED blinking demo.
# The application validates hardware connectivity by controlling an LED.

# Require CMake version 3.20.0 or higher (Zephyr minimum requirement)
cmake_minimum_required(VERSION 3.20.0)

# Locate the Zephyr build system and import its CMake functions/macros
# The HINTS path uses the ZEPHYR_BASE environment variable set by the SDK
find_package(Zephyr REQUIRED HINTS $ENV{ZEPHYR_BASE})

# Define the project name - this will be the application name
project(led_bringup)

# Specify source files to compile into the application
# The 'app' target is provided by Zephyr and represents our application binary
# We only have one source file: src/main.c
target_sources(app PRIVATE src/main.c)
```

## prj.conf
```kconfig
# ============================================================================
# DWM3001CDK LED Bring-up Configuration
# ============================================================================
# This is a minimal configuration for basic GPIO control and console output.
# The app demonstrates LED blinking as a hardware validation test.

# Enable GPIO driver for LED control
# Required for gpio_pin_*() APIs and GPIO_DT_SPEC_GET()
CONFIG_GPIO=y

# Enable serial communication subsystem
# Provides the foundation for console output (though we don't use it here)
CONFIG_SERIAL=y

# Enable console subsystem for debug output
# Allows kernel to print messages (though our app doesn't use printk)
CONFIG_CONSOLE=y

# ============================================================================
# Optional: USB CDC-ACM Console (uncomment to enable)
# ============================================================================
# If you want to add USB serial console support later for debugging:
#
# CONFIG_USB_DEVICE_STACK=y         # Enable USB device stack
# CONFIG_USB_CDC_ACM=y             # Enable USB CDC-ACM (serial over USB)
# CONFIG_UART_CONSOLE=y            # Enable UART console subsystem
# CONFIG_UART_CONSOLE_ON_DEV_NAME="CDC_ACM_0"  # Route console to USB CDC device
#
# With these enabled, you could add USB logging and connect to the board
# via USB on connector J20 instead of using SWD/JTAG.
```

## app.overlay
```dts
/**
 * @brief Device Tree Overlay for LED Bring-up
 *
 * This overlay adds LED configuration to the base nRF52833 device tree.
 * It defines the D12 LED on the DWM3001CDK board and creates an alias
 * for easy reference in application code.
 */

/ {
    /**
     * @brief LED subsystem node
     *
     * The "gpio-leds" compatible driver allows Zephyr to manage LEDs
     * connected to GPIO pins. This node groups all LED definitions.
     */
    leds {
        compatible = "gpio-leds";

        /**
         * @brief D12 LED definition
         *
         * Defines the D12 LED on the DWM3001CDK board:
         * - Connected to GPIO0 pin 14
         * - Active-low (LED turns on when GPIO is driven low)
         * - Labeled for identification in debug output
         *
         * The label "d12_led" creates a reference that can be used
         * with GPIO_DT_SPEC_GET() in the application code.
         */
        d12_led: led0 {
            gpios = <&gpio0 14 GPIO_ACTIVE_LOW>;  /* GPIO0 pin 14, active-low */
            label = "DWM3001CDK D12";             /* Human-readable identifier */
        };
    };

    /**
     * @brief Device tree aliases
     *
     * Creates a shortcut alias "led0" that points to our d12_led node.
     * This allows the application to reference the LED using DT_ALIAS(led0)
     * instead of the full node path, making the code more readable.
     */
    aliases {
        led0 = &d12_led;
    };
};
```

## src/main.c
```c
/**
 * @file main.c
 * @brief LED Bring-up Application for DWM3001CDK
 *
 * This application demonstrates basic GPIO control by blinking an LED.
 * It serves as a hardware validation test to ensure the development
 * board is properly connected and functioning.
 */

#include <zephyr/kernel.h>          /* Kernel APIs: k_msleep() */
#include <zephyr/drivers/gpio.h>    /* GPIO driver APIs */

/**
 * @brief Device tree node alias for our LED
 *
 * This references the LED defined in the device tree overlay (app.overlay).
 * The alias "led0" points to the d12_led node which maps to GPIO pin 14.
 */
#define LED_NODE DT_ALIAS(led0)

/**
 * @brief Compile-time check for device tree overlay
 *
 * Ensures the LED device tree node is properly defined and enabled.
 * If this fails, the build will stop with a clear error message indicating
 * the overlay wasn't applied correctly.
 */
#if !DT_NODE_HAS_STATUS(LED_NODE, okay)
#error "led0 alias missing (overlay not applied?)"
#endif

/**
 * @brief GPIO specification for the LED
 *
 * This structure contains all the information needed to control the LED:
 * - Which GPIO port (gpio0 on nRF52833)
 * - Which pin number (14 for D12 LED)
 * - Active level (low = LED on, based on overlay configuration)
 */
static const struct gpio_dt_spec led = GPIO_DT_SPEC_GET(LED_NODE, gpios);

/**
 * @brief Main application entry point
 *
 * Initializes the LED GPIO and enters an infinite blink loop.
 * The LED blinks at approximately 0.5 Hz (on for 1s, off for 1s).
 */
void main(void) {
    /* Verify the GPIO device is ready before proceeding */
    if (!device_is_ready(led.port)) {
        /* If GPIO isn't ready, we can't continue. In a production app,
         * you might want to log this error or retry initialization. */
        return;
    }

    /* Configure the GPIO pin as an output, initially inactive (LED off).
     * GPIO_OUTPUT_INACTIVE means the pin will be set to its inactive state,
     * which is high for active-low LEDs like our D12 LED. */
    gpio_pin_configure_dt(&led, GPIO_OUTPUT_INACTIVE);

    /* Main blink loop - runs forever */
    while (1) {
        /* Toggle the LED state (on->off or off->on) */
        gpio_pin_toggle_dt(&led);

        /* Sleep for 1000ms (1 second) before next toggle.
         * This creates a 50% duty cycle blink pattern. */
        k_msleep(1000);
    }
}
```
